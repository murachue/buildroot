## boot/n64rom/Config.in
```kconfig
config BR2_TARGET_N64ROM
	bool "N64 ROM-ify"
	depends on BR2_mips || BR2_mips64
	help
	  Small bootloaders for Nintendo 64
```

## configs/nintendo64_defconfig
```kconfig
BR2_mips=y
BR2_mips3_32=y
# BR2_MIPS_SOFT_FLOAT is not set
BR2_DLBACKEND_CURL=y
BR2_JLEVEL=1
BR2_PACKAGE_HOST_LINUX_HEADERS_CUSTOM_4_4=y
BR2_TOOLCHAIN_BUILDROOT_GLIBC=y
BR2_GLIBC_VERSION_2_22=y
BR2_BINUTILS_VERSION_2_25_X=y
BR2_BINUTILS_EXTRA_CONFIG_OPTIONS="CFLAGS=-g3"
BR2_GCC_ENABLE_LTO=y
BR2_PACKAGE_HOST_GDB=y
BR2_PACKAGE_HOST_GDB_TUI=y
BR2_GDB_VERSION_7_10=y
BR2_TARGET_GENERIC_ISSUE="Welcome to N64"
BR2_INIT_BIN_SH=y
BR2_ROOTFS_MERGED_USR=y
BR2_TARGET_GENERIC_ROOT_PASSWD="hogehoge"
# BR2_TARGET_GENERIC_GETTY is not set
# BR2_TARGET_GENERIC_REMOUNT_ROOTFS_RW is not set
BR2_LINUX_KERNEL=y
BR2_LINUX_KERNEL_CUSTOM_LOCAL=y
BR2_LINUX_KERNEL_CUSTOM_LOCAL_PATH="n64/linux-stable"
BR2_LINUX_KERNEL_USE_CUSTOM_CONFIG=y
BR2_LINUX_KERNEL_CUSTOM_CONFIG_FILE="board/nintendo64/linux.config"
BR2_LINUX_KERNEL_VMLINUX_BIN=y
BR2_BUSYBOX_CUSTOM_LOCAL=y
BR2_BUSYBOX_CUSTOM_LOCAL_PATH="n64/busybox"
BR2_PACKAGE_BUSYBOX_CONFIG="board/nintendo64/busybox.config"
BR2_PACKAGE_DROPBEAR=y
# BR2_PACKAGE_DROPBEAR_CLIENT is not set
BR2_PACKAGE_PPPD=y
BR2_TARGET_ROOTFS_ISO9660=y
# BR2_TARGET_ROOTFS_ISO9660_INITRD is not set
# BR2_TARGET_ROOTFS_TAR is not set
BR2_TARGET_N64ROM=y
BR2_PACKAGE_HOST_LIBDRAGON=y
BR2_LIBDRAGON_LATEST_VERSION=y
```

## package/libdragon/Config.in
```kconfig
config BR2_PACKAGE_LIBDRAGON
	bool "libdragon"
	default n
	depends on BR2_mips || BR2_mips64
	help
	  The homebrew library for developing Nintendo 64.
	  It contains a library for developing, tools for creating N64 ROMs.

if BR2_PACKAGE_LIBDRAGON

choice
	prompt "libdragon version"

config BR2_LIBDRAGON_STABLE_VERSION
	bool "02-29-2012"

config BR2_LIBDRAGON_LATEST_VERSION
	bool "git master"

config BR2_LIBDRAGON_CUSTOM_LOCAL
	bool "Local directory"

endchoice

config BR2_LIBDRAGON_CUSTOM_LOCAL_PATH
	string "Path to the local directory"
	depends on BR2_LIBDRAGON_CUSTOM_LOCAL
	help
	  Path to the local directory with the libdragon source code.

config BR2_LIBDRAGON_VERSION
	string
	default "02-29-2012" if BR2_LIBDRAGON_STABLE_VERSION
	default "master" if BR2_LIBDRAGON_LATEST_VERSION
	default "custom" if BR2_LIBDRAGON_CUSTOM_LOCAL

config BR2_PACKAGE_LIBDRAGON_N64TOOLSONLY
	bool "Build N64 ROM tools only"
	help
	  Build N64 ROM tools only. This is enough for just running Linux
	  system on Nintendo 64.
	  If you are planning to develop libdragon-based N64 apps, say N.

endif
```

## package/libdragon/Config.in.host
```kconfig
config BR2_PACKAGE_HOST_LIBDRAGON
	bool "host libdragon tools"
	default n
	depends on BR2_mips || BR2_mips64
	help
	  The homebrew library for developing Nintendo 64.
	  It contains tools for creating N64 ROMs.

config BR2_PACKAGE_HOST_LIBDRAGON_ALLTOOLS
	bool "Also build tools for libdragon itself"
	depends on BR2_PACKAGE_HOST_LIBDRAGON
	help
	  Build libdragon tools too. This is not requred to run Linux system
	  on Nintendo 64.
	  It's safe to say N.

if BR2_PACKAGE_LIBDRAGON || BR2_PACKAGE_HOST_LIBDRAGON

choice
	prompt "libdragon version"

config BR2_LIBDRAGON_STABLE_VERSION
	bool "02-29-2012"

config BR2_LIBDRAGON_LATEST_VERSION
	bool "git master"

config BR2_LIBDRAGON_CUSTOM_LOCAL
	bool "Local directory"

endchoice

config BR2_LIBDRAGON_CUSTOM_LOCAL_PATH
	string "Path to the local directory"
	depends on BR2_LIBDRAGON_CUSTOM_LOCAL
	help
	  Path to the local directory with the libdragon source code.

config BR2_LIBDRAGON_VERSION
	string
	default "02-29-2012" if BR2_LIBDRAGON_STABLE_VERSION
	default "master" if BR2_LIBDRAGON_LATEST_VERSION
	default "custom" if BR2_LIBDRAGON_CUSTOM_LOCAL

endif
```
